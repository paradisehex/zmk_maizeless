## boards/shields/maizeless/Kconfig.defconfig
```kconfig
if SHIELD_MAIZELESS_LEFT

config ZMK_KEYBOARD_NAME
    default "Maizeless"

config ZMK_SPLIT_ROLE_CENTRAL
    default y

endif

if SHIELD_MAIZELESS_LEFT || SHIELD_MAIZELESS_RIGHT

config ZMK_SPLIT
    default y

endif
```

## config/boards/shields/maizeless/Kconfig.shield
```kconfig
# Copyright (c) 2020 Pete Johanson
# SPDX-License-Identifier: MIT

config SHIELD_MAIZELESS_LEFT
    def_bool $(shields_list_contains,maizeless_left)

config SHIELD_MAIZELESS_RIGHT
    def_bool $(shields_list_contains,maizeless_right)
```
