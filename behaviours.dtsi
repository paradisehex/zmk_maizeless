#include <dt-bindings/zmk/keys.h>

/ {
    behaviors {
        td: tap_dance {
            compatible = "zmk,behavior-tap-dance";
            label = "TAP_DANCE";
            #binding-cells = <0>;
            tapping-term-ms = <200>;
            quick-tap-ms = <200>;
            bindings = <&kp TD_SNAKE_CASE>;
        };
        hrm: home_row_mods {
            compatible = "zmk,behavior-hold-tap";
            #binding-cells = <2>;
            flavor = "tap-preferred";
            tapping-term-ms = <200>;
            quick-tap-ms = <200>;
            require-prior-idle-ms = <165>;
            bindings = <&kp>, <&kp>;
        };

        &mt &hrm;
        &lt &hrm;


    };

};
